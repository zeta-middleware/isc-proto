## CMakeLists.txt
```
# SPDX-License-Identifier: Apache-2.0

cmake_minimum_required(VERSION 3.13.1)

find_package(Zephyr REQUIRED HINTS $ENV{ZEPHYR_BASE})
project(isc_proto)
# Generate version file
set(CMAKE_EXPORT_COMPILE_COMMANDS ON)

list(APPEND HEADERS
  "${PROJECT_BINARY_DIR}/zephyr/include/generated"
  "${PROJECT_SOURCE_DIR}/include"
  )
include_directories(${HEADERS})

list(APPEND SOURCES
  "${PROJECT_SOURCE_DIR}/src/main.c"
  "${PROJECT_SOURCE_DIR}/src/zt_uart.c"
  )
target_sources(app PRIVATE ${SOURCES})
```

## prj.conf
```kconfig
# Still nothing here
```

## src/main.c
```c
/*!
 * SPDX-License-Identifier: Apache-2.0
 */

#include <string.h>
#include <sys/crc.h>
#include <sys/printk.h>
#include <zephyr.h>
#include <zt_uart.h>
#include "kernel.h"

#define ZT_ISC_PKT_ASSERT_EQ(actual, expected, ret) \
    if (actual != expected) {                       \
        return ret;                                 \
    }

#define ZT_ISC_PKT_ASSERT(cond, ret) \
    if (!(cond)) {                   \
        return ret;                  \
    }
struct zt_isc_header_op {
    uint8_t type : 2;     /**!> 0: event, 1: command, 2: response, 3: reserved */
    uint8_t has_data : 1; /**!> 0: no data, 1: contains data */
    uint8_t cmd : 5;      /**!> 0: pub, 1: read, 2..: reserved */
    uint8_t channel : 8;  /**!> 256 channels available*/
};


struct zt_isc_header_data_info {
    uint8_t crc : 8;  /**!> CCITT 8, polynom 0x07, initial value 0x00 */
    uint8_t size : 8; /**!> data size */
};

void main(void)
{
    if (uart_open("UART_0")) {
        return;
    }

    uint8_t buffer[]                  = {10, 111, 2, 3, 4, 5, 6, 7, 8, 9};
    struct zt_isc_header_op h         = {0};
    h.type                            = 3;
    h.has_data                        = 1;
    h.cmd                             = 8;
    h.channel                         = 2;
    struct zt_isc_header_data_info hd = {0};
    hd.crc                            = crc8(buffer, sizeof(buffer), 0x07, 0x00, 0);
    hd.size                           = sizeof(buffer);

    uart_write((uint8_t *) &h, sizeof(struct zt_isc_header_op));
    uart_write((uint8_t *) &hd, sizeof(struct zt_isc_header_data_info));
    uart_write(buffer, sizeof(buffer));
    char data = 0;
    while (1) {
        if (!k_msgq_get(uart_get_input_msgq(), &data, K_FOREVER)) {
            uart_write_byte(&data);
        }
    }
}
```

## include/zt_uart.h
```c
#ifndef _ZT_UART_H_
#define _ZT_UART_H_

#include <device.h>
#include <zephyr.h>

int uart_open(char *dev_label);

int uart_write(uint8_t *data, size_t size);

int uart_write_byte(uint8_t *byte);

struct k_msgq *uart_get_input_msgq();

struct k_msgq *uart_get_output_msgq();

#endif  // _ZT_UART_H_
```

## src/zt_uart.c
```c
#include "zt_uart.h"
#include <drivers/uart.h>
#include <zephyr.h>

static const struct device *__uart_dev = 0;
K_MSGQ_DEFINE(__input_msgq, sizeof(uint8_t), 512, 1);
K_MSGQ_DEFINE(__output_msgq, sizeof(uint8_t), 512, 1);

const struct uart_config uart_cfg = {.baudrate  = 115200,
                                     .parity    = UART_CFG_PARITY_NONE,
                                     .stop_bits = UART_CFG_STOP_BITS_1,
                                     .data_bits = UART_CFG_DATA_BITS_8,
                                     .flow_ctrl = UART_CFG_FLOW_CTRL_NONE};

static void uart_fifo_callback(const struct device *dev, void *user_data)
{
    uint8_t data = 0;
    if (!uart_irq_update(dev)) {
        return;
    }

    if (uart_irq_tx_ready(dev)) {
        if (!k_msgq_get(&__output_msgq, &data, K_NO_WAIT)) {
            uart_fifo_fill(dev, &data, sizeof(uint8_t));
        } else {
            uart_irq_tx_disable(dev);
        }
    }

    data = 0;

    if (uart_irq_rx_ready(dev)) {
        uart_fifo_read(dev, &data, sizeof(uint8_t));
        k_msgq_put(&__input_msgq, &data, K_NO_WAIT);
    }
}

struct k_msgq *uart_get_input_msgq()
{
    return &__input_msgq;
}

struct k_msgq *uart_get_output_msgq()
{
    return &__output_msgq;
}

int uart_open(char *dev_label)
{
    const struct device *dev = device_get_binding(dev_label);
    __uart_dev               = dev;

    if (dev == NULL) {
        printk("The UART device was not found.\n");
        return -EINVAL;
    }

    /* Verify configure() - set device configuration using data in cfg */
    int ret = uart_configure(dev, &uart_cfg);

    if (ret == -ENOTSUP) {
        return -ENOTSUP;
    }

    uart_irq_callback_set(dev, uart_fifo_callback);
    uart_irq_rx_enable(dev);

    return 0;
}

int uart_write(uint8_t *data, size_t size)
{
    if (__uart_dev == NULL) {
        return -ENODEV;
    }
    int err            = 0;
    uint8_t *data_end  = data + size;
    uint8_t *data_iter = data;
    for (; data_iter < data_end; ++data_iter) {
        err = err || k_msgq_put(&__output_msgq, data_iter, K_MSEC(10));
    }

    uart_irq_tx_enable(__uart_dev);

    return err;
}

int uart_write_str(char *str)
{
    if (__uart_dev == NULL) {
        return -ENODEV;
    }
    int err         = 0;
    char *data_iter = str;
    for (; *data_iter != '\0'; ++data_iter) {
        err = err || k_msgq_put(&__output_msgq, data_iter, K_MSEC(10));
    }

    uart_irq_tx_enable(__uart_dev);

    return err;
}

int uart_write_byte(uint8_t *byte)
{
    if (__uart_dev == NULL) {
        return -ENODEV;
    }
    int err = k_msgq_put(&__output_msgq, byte, K_MSEC(10));
    if (!err) {
        uart_irq_tx_enable(__uart_dev);
    }
    return err;
}
```
